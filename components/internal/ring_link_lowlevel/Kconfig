## components/internal/ring_link_lowlevel/Kconfig
```kconfig
menu "Internet for all: Ring Link Lowlevel Configuration"
    choice RING_LINK_LOWLEVEL_IMPL
        prompt "Lowlevel Implementation"
        default RING_LINK_LOWLEVEL_IMPL_SPI

    config RING_LINK_LOWLEVEL_IMPL_SPI
        bool "SPI"

    config RING_LINK_LOWLEVEL_IMPL_PHYSIM
        bool "PHYSIM"

    endchoice
endmenu
```

## components/internal/wifi/Kconfig
```kconfig
menu "Internet for all: Wi-Fi Configuration"
    choice WIFI_MODE
        prompt "Wi-Fi Mode"
        default WIFI_NORMAL_MODE

    config WIFI_NORMAL_MODE
        bool "NORMAL"

    config WIFI_TEST_MODE
        bool "TEST"

    endchoice
    
    config WIFI_SSID
        string "WiFi SSID"
        default "myssid"
        help
            SSID (network name) for the example to connect to.

    config WIFI_PASSWORD
        string "WiFi Password"
        default "mypassword"
        help
            WiFi password (WPA or WPA2) for the example to use.
    config WIFI_CHANNEL
        int "WiFi Channel"
        range 1 13
        default 1
        help
            WiFi channel (network channel) for the example to use.

    config WIFI_MAX_STA_CONN
        int "Maximal STA connections"
        default 4
        help
            Max number of the STA connects to AP.
endmenu
```

## components/sdkconfig.defaults
```kconfig
CONFIG_LWIP_L2_TO_L3_COPY=y
CONFIG_LWIP_IP_FORWARD=y
CONFIG_LWIP_IP_DEBUG=n
CONFIG_LOG_DEFAULT_LEVEL_NONE=n
CONFIG_LOG_DEFAULT_LEVEL_ERROR=n
CONFIG_LOG_DEFAULT_LEVEL_WARN=n
CONFIG_LOG_DEFAULT_LEVEL_INFO=y
CONFIG_LOG_DEFAULT_LEVEL_DEBUG=n
CONFIG_LOG_DEFAULT_LEVEL_VERBOSE=n
```

## components/spi/Kconfig
```kconfig
menu "Internet for all: SPI Configuration"
    choice SPI_FREQ
        prompt "SPI Freq"
        default SPI_FREQ_8M

    config SPI_FREQ_8M
        bool "SPI_FREQ_8M"
    config SPI_FREQ_9M
        bool "SPI_FREQ_9M"
    config SPI_FREQ_10M
        bool "SPI_FREQ_10M"
    config SPI_FREQ_11M
        bool "SPI_FREQ_11M"
    config SPI_FREQ_13M
        bool "SPI_FREQ_13M"
    config SPI_FREQ_16M
        bool "SPI_FREQ_16M"
    config SPI_FREQ_20M
        bool "SPI_FREQ_20M"
    config SPI_FREQ_26M
        bool "SPI_FREQ_26M"
    config SPI_FREQ_40M
        bool "SPI_FREQ_40M"
    config SPI_FREQ_80M
        bool "SPI_FREQ_80M"
    endchoice

    config SPI_BUFFER_SIZE
        int "SPI Buffer size"
        range 200 600
        default 240

endmenu
```
